## sources/meta-cm/conf/distro/cm-equalizer.conf
```bitbake
#require conf/distro/poky.conf

DISTRO_NAME = "CM Equalizer Linux"
DISTRO_VERSION = "0.1"

#DISTRO_FEATURES_append = " systemd wifi"

LAYER_CONF_VERSION = "1"

MACHINE_ESSENTIAL_EXTRA_RDEPENDS = ""

#VIRTUAL-RUNTIME_init_manager = "systemd"
#VIRTUAL-RUNTIME_initscripts = "systemd-compat-units"
#DISTRO_FEATURES_BACKFILL_CONSIDERED="sysvinit"

# Enable some of the supported VPN technogies in ConnMan
#PACKAGECONFIG_append_pn-connman = " openvpn l2tp pptp"
```

## sources/meta-cm/conf/distro/equalizer-distro.conf
```bitbake
require conf/distro/poky.conf
# distro name
DISTRO = "equalizer-distro"
DISTRO_NAME = "CM Comandos Equalizer distribution"
DISTRO_VERSION = "1.0"
DISTRO_CODENAME = "equalizer distro"
DISTRO_FEATURES_append = " wifi "
SDK_VENDOR = "-phi"
SDK_VERSION := "${@'${DISTRO_VERSION}'.replace('snapshot-${DATE}','snapshot')}"
MAINTAINER = "phi "
INHERIT += "buildhistory extrausers"
EXTRA_USERS_PARAMS = "usermod -P phi2018 root;"
BUILDHISTORY_COMMIT = "1"
DEFAULT_TIMEZONE = "America/Sao_Paulo"

VIRTUAL-RUNTIME_snmp-manager = "net-snmp-server"
```

## sources/meta-cm/conf/machine/equalizer-base.inc
```bitbake
# Provides the i.MX common settings

include conf/machine/include/fsl-default-settings.inc
include conf/machine/include/fsl-default-versions.inc

include conf/machine/include/soc-family.inc

# Set specific make target and binary suffix
PREFERRED_PROVIDER_u-boot ??= "u-boot-fslc"
PREFERRED_PROVIDER_virtual/bootloader ??= "u-boot-fslc"

PREFERRED_PROVIDER_u-boot-mxsboot-native ??= "u-boot-fslc-mxsboot-native"

UBOOT_MAKE_TARGET ?= "u-boot.imx"
UBOOT_MAKE_TARGET_mxs ?= "u-boot.sb"

UBOOT_SUFFIX ?= "imx"
UBOOT_SUFFIX_mxs ?= "sb"

UBOOT_ENTRYPOINT_mxs = "0x40008000"

# Ship kernel modules
MACHINE_EXTRA_RRECOMMENDS = "kernel-modules"

# Sub-architecture support
MACHINE_SOCARCH_SUFFIX ?= ""

INHERIT += "fsl-dynamic-packagearch"

# Firmware
MACHINE_FIRMWARE ?= ""

MACHINE_EXTRA_RRECOMMENDS += "${MACHINE_FIRMWARE}"

# Extra udev rules
MACHINE_EXTRA_RRECOMMENDS += "udev-rules-imx"

# GStreamer 1.0 plugins
MACHINE_GSTREAMER_1_0_PLUGIN ?= ""

# Handle default kernel
IMX_DEFAULT_KERNEL = "linux-cm"
IMX_DEFAULT_KERNEL_mxs = "linux-cm"
PREFERRED_PROVIDER_virtual/kernel ??= "${IMX_DEFAULT_KERNEL}"

SOC_DEFAULT_IMAGE_FSTYPES = "sdcard.gz tar.bz2"
SOC_DEFAULT_IMAGE_FSTYPES_mxs = "uboot.mxsboot-sdcard sdcard.gz tar.bz2"

SDCARD_ROOTFS ?= "${DEPLOY_DIR_IMAGE}/${IMAGE_NAME}.rootfs.ext3"
IMAGE_FSTYPES ?= "${SOC_DEFAULT_IMAGE_FSTYPES}"

SERIAL_CONSOLE = "115200 ttymxc0"
SERIAL_CONSOLE_mxs = "115200 ttyAMA0"

KERNEL_IMAGETYPE = "zImage"

MACHINE_FEATURES = "usbgadget usbhost vfat"

# Add the ability to specify _imx machines
MACHINEOVERRIDES =. "imx:"
```

## sources/meta-cm/conf/machine/equalizer-kit.conf
```bitbake
#@TYPE: Machine
#@NAME: CM Equalizer 
#@SOC: i.MX6UL
#@DESCRIPTION: Machine configuration for CM Equalizer
#@MAINTAINER: Phi Innovations

include conf/machine/equalizer-base.inc
include conf/machine/include/tune-cortexa7.inc

IMX_DEFAULT_KERNEL = "linux-cm-kit"
IMX_DEFAULT_KERNEL_mxs = "linux-cm-kit"
IMX_DEFAULT_KERNEL_mx6 = "linux-cm-kit"
IMX_DEFAULT_KERNEL_mx6ul = "linux-cm-kit"
PREFERRED_PROVIDER_virtual/kernel ??= "${IMX_DEFAULT_KERNEL}"

SOC_FAMILY = "mx6ul"

KERNEL_DEVICETREE = "imx6ul-14x14-evk.dtb imx6ul-14x14-evk-csi.dtb imx6ul-14x14-evk-btwifi.dtb"

UBOOT_CONFIG ??= "emmc"
UBOOT_CONFIG[sd] = "mx6ul_14x14_evk_config,sdcard"
UBOOT_CONFIG[emmc] = "mx6ul_14x14_evk_emmc_config,sdcard"
UBOOT_CONFIG[qspi1] = "mx6ul_14x14_evk_qspi1_config"
UBOOT_CONFIG[mfgtool] = "mx6ul_14x14_evk_config"
```

## sources/meta-cm/conf/machine/equalizer.conf
```bitbake
#@TYPE: Machine
#@NAME: CM Equalizer 
#@SOC: i.MX6UL
#@DESCRIPTION: Machine configuration for CM Equalizer
#@MAINTAINER: Phi Innovations

include conf/machine/equalizer-base.inc
include conf/machine/include/tune-cortexa7.inc

SOC_FAMILY = "mx6ul"

KERNEL_DEVICETREE = "imx6ul-14x14-evk.dtb imx6ul-14x14-evk-csi.dtb imx6ul-14x14-evk-btwifi.dtb"

UBOOT_CONFIG ??= "emmc"
UBOOT_CONFIG[sd] = "mx6ul_14x14_evk_config,sdcard"
UBOOT_CONFIG[emmc] = "mx6ul_14x14_evk_emmc_config,sdcard"
UBOOT_CONFIG[qspi1] = "mx6ul_14x14_evk_qspi1_config"
UBOOT_CONFIG[mfgtool] = "mx6ul_14x14_evk_config"
```
